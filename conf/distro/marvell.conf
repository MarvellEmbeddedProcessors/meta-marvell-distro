## conf/distro/marvell.conf
```bitbake
# Use O.S. Systems Embedded Linux as base
require conf/distro/oel.conf

### Marvell Embedded Linux specific settings

DISTRO = "marvell"
DISTRO_VERSION = "2.1"
DISTRO_NAME = "Marvell Embedded Linux"
SDK_VENDOR = "-marvellsdk"
SDK_VERSION := "${@'${DISTRO_VERSION}'.replace('snapshot-${DATE}','snapshot')}"

TARGET_VENDOR = "-marvell"

### Enable release bundle generation
INHERIT += "release-bundle"
RELEASE_BUNDLE_RECIPES_WITH_SOURCE = " \
    arm-trusted-firmware-marvell-prv \
    edk-marvell-prv \
    u-boot-marvell \
    linux-marvell \
"

INHERIT_remove = "uninative"
```

## conf/layer.conf
```bitbake
# We have a conf and classes directory, add to BBPATH
BBPATH .= ":${LAYERDIR}"

# We have a recipes-* directories, add to BBFILES
BBFILES += "${LAYERDIR}/recipes-*/*/*.bb \
	${LAYERDIR}/recipes-*/*/*.bbappend \
	${LAYERDIR}/classes/*.bbclass \
"

BBFILE_COLLECTIONS += "marvell-distro-layer"
BBFILE_PATTERN_marvell-distro-layer = "^${LAYERDIR}/"
BBFILE_PRIORITY_marvell-distro-layer = "7"

LAYERDEPENDS_marvell-distro-layer = "core marvell-layer filesystems-layer"

WAF_CROSS_ANSWERS_MARVELL_PATH = "${LAYERDIR}/files/waf-cross-answers"
```
